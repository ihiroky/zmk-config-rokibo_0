## boards/shields/rokibo_0/Kconfig.defconfig
```kconfig
if SHIELD_ROKIBO_0_RIGHT

config ZMK_KEYBOARD_NAME
    default "rokibo_0"

config ZMK_SPLIT
    default y

config ZMK_SPLIT_ROLE_CENTRAL
    default y

endif # SHIELD_ROKIBO_0_RIGHT

if SHIELD_ROKIBO_0_LEFT

config ZMK_KEYBOARD_NAME
    default "rokibo_0"

config ZMK_SPLIT
    default y

endif # SHIELD_ROKIBO_0_LEFT
```

## boards/shields/rokibo_0/Kconfig.shield
```kconfig
config SHIELD_ROKIBO_0_LEFT
    def_bool $(shields_list_contains,rokibo_0_left)

config SHIELD_ROKIBO_0_RIGHT
    def_bool $(shields_list_contains,rokibo_0_right)
```

## config/west.yml
```yaml
manifest:
  remotes:
    - name: zmkfirmware
      url-base: https://github.com/zmkfirmware
    - name: ihiroky
      url-base: https://github.com/ihiroky
    - name: caksoylar
      url-base: https://github.com/caksoylar
  projects:
    - name: zmk
      remote: zmkfirmware
      revision: v0.3-branch
      import: app/west.yml
    - name: zmk-pmw3610-driver
      remote: ihiroky
      revision: main
    - name: zmk-rgbled-widget
      remote: caksoylar
      revision: v0.3-branch
  self:
    path: config
```
